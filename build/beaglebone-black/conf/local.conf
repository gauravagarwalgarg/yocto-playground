## build/beaglebone-black/conf/local.conf
```bitbake
MACHINE = "beaglebone-black"
DISTRO = "auton"

DL_DIR = "${TOPDIR}/../../downloads"
SSTATE_DIR = "${TOPDIR}/../../sstate-cache"

PACKAGE_CLASSES = "package_ipk"
EXTRA_IMAGE_FEATURES ?= "debug-tweaks"

BB_NUMBER_THREADS = "${@oe.utils.cpu_count()}"
PARALLEL_MAKE = "-j ${@oe.utils.cpu_count()}"

# Accept all licenses for development
LICENSE_FLAGS_ACCEPTED = "commercial"

# Disk space monitoring
BB_DISKMON_DIRS ??= "\
    STOPTASKS,${TMPDIR},1G,100K \
    STOPTASKS,${DL_DIR},1G,100K \
    STOPTASKS,${SSTATE_DIR},1G,100K \
    STOPTASKS,/tmp,100M,100K \
    HALT,${TMPDIR},100M,1K \
    HALT,${DL_DIR},100M,1K \
    HALT,${SSTATE_DIR},100M,1K \
    HALT,/tmp,10M,1K \
"
```

## build/raspberrypi5/conf/bblayers.conf
```bitbake
POKY_BBLAYERS_CONF_VERSION = "2"

BBPATH = "${TOPDIR}"
BBFILES ?= ""

BBLAYERS ?= " \
  ${TOPDIR}/../../sources/poky/meta \
  ${TOPDIR}/../../sources/poky/meta-poky \
  ${TOPDIR}/../../sources/poky/meta-yocto-bsp \
  ${TOPDIR}/../../sources/meta-openembedded/meta-oe \
  ${TOPDIR}/../../sources/meta-openembedded/meta-networking \
  ${TOPDIR}/../../sources/meta-openembedded/meta-python \
  ${TOPDIR}/../../sources/meta-raspberrypi \
  ${TOPDIR}/../../sources/meta-auton \
"
```

## meta-auton/conf/distro/auton.conf
```bitbake
# Auton Embedded Linux Distribution
#
# A minimal, systemd-based embedded Linux distribution targeting
# BeagleBone Black and Raspberry Pi 5. Built on Yocto Scarthgap LTS
# with Linux kernel 6.12 LTS.

DISTRO = "auton"
DISTRO_NAME = "Auton Embedded Linux"
DISTRO_VERSION = "1.0.0"
DISTRO_CODENAME = "genesis"

# Maintainer
MAINTAINER = "Gaurav Agarwal <gauravagarwalgarg@gmail.com>"

# Base distro features
DISTRO_FEATURES = " \
    systemd \
    usrmerge \
    ipv4 \
    ipv6 \
    wifi \
    bluetooth \
    usbhost \
    pam \
    seccomp \
"

# Remove sysvinit (systemd only)
DISTRO_FEATURES:remove = "sysvinit"

# Init manager
VIRTUAL-RUNTIME_init_manager = "systemd"
VIRTUAL-RUNTIME_initscripts = "systemd-compat-units"
VIRTUAL-RUNTIME_login_manager = "shadow-base"

# Package management
PACKAGE_CLASSES = "package_ipk"

# Kernel preference: Linux 6.12 LTS from meta-auton
PREFERRED_PROVIDER_virtual/kernel = "linux-auton"
PREFERRED_VERSION_linux-auton = "6.12%"

# Toolchain
GCCVERSION = "13.%"
GLIBCVERSION = "2.39%"

# Security hardening
SECURITY_CFLAGS = "-fstack-protector-strong -D_FORTIFY_SOURCE=2"
SECURITY_LDFLAGS = "-Wl,-z,relro,-z,now"

# Image defaults
IMAGE_FSTYPES = "tar.xz wic wic.bmap"

# SDK
SDK_NAME = "${DISTRO}-${TCLIBC}-${SDKMACHINE}-${IMAGE_BASENAME}-${TUNE_PKGARCH}-${MACHINE}"

# Version tracking
DISTRO_VERSION[vardepsexclude] = "DATE"
SDK_VERSION = "${DISTRO_VERSION}"
```

## meta-auton/conf/layer.conf
```bitbake
# Layer configuration for meta-auton
# Custom distro + BSP layer for embedded Linux targets
# Supports: qemu-arm64, beaglebone-black, raspberrypi5

BBPATH .= ":${LAYERDIR}"

BBFILES += " \
    ${LAYERDIR}/recipes-*/*/*.bb \
    ${LAYERDIR}/recipes-*/*/*.bbappend \
"

BBFILE_COLLECTIONS += "meta-auton"
BBFILE_PATTERN_meta-auton = "^${LAYERDIR}/"
BBFILE_PRIORITY_meta-auton = "10"

LAYERDEPENDS_meta-auton = "core"

# Scarthgap LTS baseline + future releases
LAYERSERIES_COMPAT_meta-auton = "scarthgap styhead"
```

## meta-auton/conf/machine/beaglebone-black.conf
```bitbake
#@TYPE: Machine
#@NAME: BeagleBone Black
#@DESCRIPTION: Machine configuration for BeagleBone Black (AM335x)

require conf/machine/include/ti-soc.inc

SOC_FAMILY = "ti-am335x"
DEFAULTTUNE = "cortexa8hf-neon"
require conf/machine/include/arm/armv7a/tune-cortexa8.inc

PREFERRED_PROVIDER_virtual/kernel = "linux-auton"
PREFERRED_VERSION_linux-auton = "6.12%"

KERNEL_IMAGETYPE = "zImage"
KERNEL_DEVICETREE = "am335x-boneblack.dtb"

UBOOT_MACHINE = "am335x_evm_defconfig"
SPL_BINARY = "MLO"
UBOOT_SUFFIX = "img"

MACHINE_FEATURES = "usbgadget usbhost vfat ext2 screen alsa ethernet wifi"
MACHINE_EXTRA_RRECOMMENDS = "kernel-modules kernel-devicetree"

SERIAL_CONSOLES = "115200;ttyS0"
IMAGE_FSTYPES = "tar.xz wic wic.bmap"
WKS_FILE = "beaglebone-yocto.wks"
```

## meta-auton/conf/machine/qemu-arm.conf
```bitbake
#@TYPE: Machine
#@NAME: QEMU ARM 32-bit
#@DESCRIPTION: QEMU ARM machine for local development and CI (vexpress-a15)
#
# Use this for WSL/local builds where you don't have hardware.
# Run with: runqemu qemu-arm nographic

require conf/machine/include/arm/armv7a/tune-cortexa15.inc
require conf/machine/include/qemu.inc

PREFERRED_PROVIDER_virtual/kernel = "linux-auton"
PREFERRED_VERSION_linux-auton = "6.12%"

KERNEL_IMAGETYPE = "zImage"

# QEMU settings
QB_SYSTEM_NAME = "qemu-system-arm"
QB_MACHINE = "-machine vexpress-a15"
QB_CPU = "-cpu cortex-a15"
QB_MEM = "-m 1024"
QB_KERNEL_CMDLINE_APPEND = "console=ttyAMA0,115200 root=/dev/vda rw"
QB_DEFAULT_FSTYPE = "ext4"
QB_TAP_OPT = "-netdev tap,id=net0,ifname=@TAP@,script=no,downscript=no"
QB_NETWORK_DEVICE = "-device virtio-net-device,netdev=net0,mac=@MAC@"
QB_DRIVE_TYPE = "/dev/vd"
QB_ROOTFS_OPT = "-drive id=disk0,file=@ROOTFS@,if=none,format=raw -device virtio-blk-device,drive=disk0"
QB_SERIAL_OPT = "-serial mon:stdio"
QB_GRAPHICS = ""

MACHINE_FEATURES = "usbhost vfat ext2 screen alsa ethernet"
MACHINE_EXTRA_RRECOMMENDS = "kernel-modules"

SERIAL_CONSOLES = "115200;ttyAMA0"
IMAGE_FSTYPES = "tar.xz ext4 wic"
```

## meta-auton/conf/machine/qemu-arm64.conf
```bitbake
#@TYPE: Machine
#@NAME: QEMU AArch64
#@DESCRIPTION: QEMU AArch64 machine for local development and CI (virt)
#
# Use this for WSL/local builds where you don't have hardware.
# Run with: runqemu qemu-arm64 nographic
# With KVM (if available): runqemu qemu-arm64 nographic kvm

require conf/machine/include/arm/arch-armv8a.inc
require conf/machine/include/qemu.inc

DEFAULTTUNE = "cortexa57"
require conf/machine/include/arm/armv8a/tune-cortexa57.inc

PREFERRED_PROVIDER_virtual/kernel = "linux-auton"
PREFERRED_VERSION_linux-auton = "6.12%"

KERNEL_IMAGETYPE = "Image"

# QEMU settings
QB_SYSTEM_NAME = "qemu-system-aarch64"
QB_MACHINE = "-machine virt"
QB_CPU = "-cpu cortex-a57"
QB_MEM = "-m 2048"
QB_KERNEL_CMDLINE_APPEND = "console=ttyAMA0,115200 root=/dev/vda rw"
QB_DEFAULT_FSTYPE = "ext4"
QB_TAP_OPT = "-netdev tap,id=net0,ifname=@TAP@,script=no,downscript=no"
QB_NETWORK_DEVICE = "-device virtio-net-device,netdev=net0,mac=@MAC@"
QB_DRIVE_TYPE = "/dev/vd"
QB_ROOTFS_OPT = "-drive id=disk0,file=@ROOTFS@,if=none,format=raw -device virtio-blk-device,drive=disk0"
QB_SERIAL_OPT = "-serial mon:stdio"
QB_GRAPHICS = ""

MACHINE_FEATURES = "usbhost vfat ext2 screen alsa ethernet"
MACHINE_EXTRA_RRECOMMENDS = "kernel-modules"

SERIAL_CONSOLES = "115200;ttyAMA0"
IMAGE_FSTYPES = "tar.xz ext4 wic"
```

## meta-auton/conf/machine/raspberrypi5.conf
```bitbake
#@TYPE: Machine
#@NAME: Raspberry Pi 5
#@DESCRIPTION: Machine configuration for Raspberry Pi 5 (BCM2712)

DEFAULTTUNE = "cortexa76"
require conf/machine/include/arm/armv8-2a/tune-cortexa76.inc

PREFERRED_PROVIDER_virtual/kernel = "linux-auton"
PREFERRED_VERSION_linux-auton = "6.12%"

KERNEL_IMAGETYPE = "Image"
KERNEL_DEVICETREE = "broadcom/bcm2712-rpi-5-b.dtb"

UBOOT_MACHINE = "rpi_arm64_defconfig"

RPI_USE_U_BOOT = "1"
ENABLE_UART = "1"
DISABLE_OVERSCAN = "1"

MACHINE_FEATURES = "usbhost wifi bluetooth alsa screen ethernet"
MACHINE_EXTRA_RRECOMMENDS = "kernel-modules kernel-devicetree linux-firmware-rpidistro-bcm43455"

SERIAL_CONSOLES = "115200;ttyAMA10"
IMAGE_FSTYPES = "tar.xz rpi-sdimg wic wic.bmap"
```

## meta-auton/recipes-kernel/linux/linux-auton/defconfig
```kconfig
# Minimal kernel config for Auton targets
# This is a placeholder - generate real defconfig with:
#   make ARCH=arm multi_v7_defconfig    (BeagleBone)
#   make ARCH=arm64 defconfig           (RPi5)
#
# Then merge with:
#   scripts/kconfig/merge_config.sh .config fragment.cfg

# Core
CONFIG_SYSVIPC=y
CONFIG_POSIX_MQUEUE=y
CONFIG_AUDIT=y
CONFIG_CGROUPS=y
CONFIG_NAMESPACES=y

# Systemd requirements
CONFIG_DEVTMPFS=y
CONFIG_DEVTMPFS_MOUNT=y
CONFIG_CGROUPS=y
CONFIG_INOTIFY_USER=y
CONFIG_SIGNALFD=y
CONFIG_TIMERFD=y
CONFIG_EPOLL=y
CONFIG_FHANDLE=y
CONFIG_DMIID=y
CONFIG_NET=y
CONFIG_SYSFS=y
CONFIG_PROC_FS=y
CONFIG_TMPFS=y
CONFIG_TMPFS_POSIX_ACL=y
CONFIG_TMPFS_XATTR=y
CONFIG_SECCOMP=y
CONFIG_SECCOMP_FILTER=y

# Networking
CONFIG_PACKET=y
CONFIG_UNIX=y
CONFIG_INET=y
CONFIG_IPV6=y
CONFIG_NETFILTER=y

# Filesystems
CONFIG_EXT4_FS=y
CONFIG_VFAT_FS=y
CONFIG_TMPFS=y
CONFIG_SQUASHFS=y

# USB
CONFIG_USB=y
CONFIG_USB_EHCI_HCD=y
CONFIG_USB_XHCI_HCD=y
CONFIG_USB_STORAGE=y

# I2C / SPI / GPIO
CONFIG_I2C=y
CONFIG_SPI=y
CONFIG_GPIOLIB=y
CONFIG_GPIO_SYSFS=y

# Serial
CONFIG_SERIAL_8250=y
CONFIG_SERIAL_8250_CONSOLE=y

# Watchdog
CONFIG_WATCHDOG=y

# Crypto (for WiFi/BT)
CONFIG_CRYPTO=y
CONFIG_CRYPTO_AES=y
CONFIG_CRYPTO_SHA256=y
```
